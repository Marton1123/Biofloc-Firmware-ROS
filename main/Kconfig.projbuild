## main/Kconfig.projbuild
```kconfig
# ==============================================================================
# Biofloc Firmware - Configuración de Red y micro-ROS
# Accesible desde: idf.py menuconfig -> Biofloc Configuration
# ==============================================================================

menu "Biofloc Configuration"

    menu "WiFi Configuration"
        config BIOFLOC_WIFI_SSID
            string "WiFi SSID"
            default "lab-ros2-nuc"
            help
                SSID (nombre) de la red WiFi a la que se conectará el ESP32.
                Gateway seguro sin acceso a Internet.

        config BIOFLOC_WIFI_PASSWORD
            string "WiFi Password"
            default "ni2dEUVd"
            help
                Contraseña de la red WiFi. Dejar vacío para redes abiertas.

        config BIOFLOC_WIFI_MAXIMUM_RETRY
            int "Maximum WiFi connection retries"
            default 15
            range 1 30
            help
                Número máximo de intentos de conexión WiFi antes de reiniciar.
    endmenu

    menu "micro-ROS Agent Configuration"
        config BIOFLOC_AGENT_IP
            string "micro-ROS Agent IP"
            default "10.42.0.1"
            help
                Dirección IP del host donde corre el micro-ROS Agent.
                En arquitectura de gateway seguro, esta es la IP del hotspot de la NUC.

        config BIOFLOC_AGENT_PORT
            int "micro-ROS Agent Port"
            default 8888
            range 1024 65535
            help
                Puerto UDP del micro-ROS Agent.

        config BIOFLOC_ROS_NAMESPACE
            string "ROS 2 Namespace"
            default "biofloc"
            help
                Namespace para los nodos y topics de ROS 2.

        config BIOFLOC_PING_TIMEOUT_MS
            int "Agent Ping Timeout (ms)"
            default 1000
            range 100 10000
            help
                Timeout en milisegundos para el ping al Agent.

        config BIOFLOC_PING_RETRIES
            int "Agent Ping Retries"
            default 10
            range 1 100
            help
                Número de reintentos de ping antes de considerar el Agent inalcanzable.
    endmenu

    menu "Sensor Configuration"
        config BIOFLOC_SENSOR_SAMPLE_INTERVAL_MS
            int "Sensor sampling interval (ms)"
            default 4000
            range 1000 60000
            help
                Intervalo de muestreo de sensores en milisegundos.

        config BIOFLOC_LOCATION
            string "Device Location"
            default "tanque_01"
            help
                Ubicación física del dispositivo (ej: tanque_01, estanque_norte).

        menu "pH Sensor"
            config BIOFLOC_PH_GPIO
                int "pH Sensor GPIO"
                default 36
                range 32 39
                help
                    GPIO para lectura analógica del sensor de pH.
                    Usar GPIOs ADC1: 32, 33, 34, 35, 36, 37, 38, 39.

            config BIOFLOC_PH_VOLTAGE_DIVIDER_FACTOR
                int "Voltage divider factor x1000"
                default 1500
                range 1000 5000
                help
                    Factor del divisor de tensión multiplicado por 1000.
                    Hardware: R1=10kΩ, R2=20kΩ -> factor=1.5 -> valor=1500.
                    V_sensor = V_adc * (factor/1000)

            config BIOFLOC_PH_ENABLED
                bool "Enable pH Sensor"
                default y
                help
                    Habilitar lectura del sensor de pH.
        endmenu

        menu "Temperature Sensor"
            config BIOFLOC_TEMP_GPIO
                int "Temperature Sensor GPIO"
                default 34
                range 32 39
                help
                    GPIO para lectura analógica del sensor de temperatura.
                    Usar GPIOs ADC1: 32, 33, 34, 35, 36, 37, 38, 39.

            config BIOFLOC_TEMP_VOLTAGE_DIVIDER_FACTOR
                int "Voltage divider factor x1000"
                default 1500
                range 1000 5000
                help
                    Factor del divisor de tensión multiplicado por 1000.
                    Hardware: R1=10kΩ, R2=20kΩ -> factor=1.5 -> valor=1500.

            config BIOFLOC_TEMP_ENABLED
                bool "Enable Temperature Sensor"
                default y
                help
                    Habilitar lectura del sensor de temperatura.

            config BIOFLOC_TEMP_SLOPE
                int "Temperature Calibration Slope x1000000"
                default 1000000
                range 500000 1500000
                depends on BIOFLOC_TEMP_ENABLED
                help
                    Pendiente de calibración de temperatura × 1000000.
                    Valor por defecto: 1.0 (sin ajuste de pendiente).
                    Usar scripts/calibrate_temperature.py para recalibrar.

            config BIOFLOC_TEMP_OFFSET_MILLIDEGREES
                int "Temperature Calibration Offset (millidegrees)"
                default 1382
                range -5000 5000
                depends on BIOFLOC_TEMP_ENABLED
                help
                    Offset de calibración en miligrados (°C × 1000).
                    Valor por defecto: +1.382°C = +1382 millidegrees (calibrado 2026-01-29).
                    Usar scripts/calibrate_temperature.py para recalibrar.
        endmenu
    endmenu

    menu "NTP Configuration"
        config BIOFLOC_NTP_SERVER
            string "NTP Server"
            default "pool.ntp.org"
            help
                Servidor NTP para sincronización de hora.

        config BIOFLOC_TIMEZONE
            string "Timezone"
            default "CLT3CLST,M10.2.0/00:00,M3.2.0/00:00"
            help
                Timezone en formato POSIX. Chile: CLT3CLST,M10.2.0/00:00,M3.2.0/00:00
    endmenu

endmenu
```

## sdkconfig.defaults
```kconfig
# ==============================================================================
# Biofloc Firmware - sdkconfig.defaults
# Configuración por defecto para ESP-IDF v5.3 + micro-ROS Jazzy
# ==============================================================================

# ---- Configuración de micro-ROS ----
CONFIG_MICRO_ROS_ESP_NETIF_WLAN=y
CONFIG_MICRO_ROS_ESP_XRCE_DDS_MIDDLEWARE=y
CONFIG_MICRO_ROS_APP_STACK=16000
CONFIG_MICRO_ROS_APP_TASK_PRIO=5

# ---- Configuración de Agent - Gateway Seguro ----
CONFIG_MICRO_ROS_AGENT_IP="10.42.0.1"
CONFIG_MICRO_ROS_AGENT_PORT=8888

# ---- WiFi - Gateway Seguro (Raspberry Pi 3) ----
# IMPORTANTE: micro_ros component usa CONFIG_ESP_WIFI_*, NO CONFIG_BIOFLOC_WIFI_*
# ⚠️ SEGURIDAD: Reemplaza con tus propias credenciales antes de compilar
CONFIG_ESP_WIFI_SSID="<tu-ssid-gateway>"
CONFIG_ESP_WIFI_PASSWORD="<tu-password-seguro>"
CONFIG_ESP_MAXIMUM_RETRY=15
CONFIG_ESP_WIFI_SCAN_RSSI_THRESHOLD=-127

# ---- Seguridad WiFi - CRITICO: Desactivar WPA3 para compatibilidad con RPi ----
# La Raspberry Pi 3 hotspot solo soporta WPA1/WPA2, NO WPA3
CONFIG_ESP_WIFI_ENABLE_WPA3_SAE=n
CONFIG_ESP_WIFI_ENABLE_WPA3_OWE_STA=n

# ---- Partición de flash ----
CONFIG_PARTITION_TABLE_CUSTOM=y
CONFIG_PARTITION_TABLE_CUSTOM_FILENAME="partitions.csv"

# ---- Tamaño de stack de tareas ----
CONFIG_ESP_MAIN_TASK_STACK_SIZE=8192

# ---- Watchdog ----
CONFIG_ESP_TASK_WDT_TIMEOUT_S=20

# ---- Logging ----
CONFIG_LOG_DEFAULT_LEVEL_INFO=y
CONFIG_LOG_DEFAULT_LEVEL=3

# ---- LWIP (requerido para micro-ROS UDP) ----
CONFIG_LWIP_SO_REUSE=y
CONFIG_LWIP_SO_RCVBUF=y

# ---- FreeRTOS ----
CONFIG_FREERTOS_HZ=1000

# ---- Temperature Sensor Calibration ----
# Calibrado 2026-01-29 con TP101
# Solo se usa offset de +1.382°C (slope=1.0, sin ajuste de pendiente)
# Hardware: Divisor R1=10kΩ, R2=20kΩ → factor 1.5
CONFIG_BIOFLOC_TEMP_SLOPE=1000000
CONFIG_BIOFLOC_TEMP_OFFSET_MILLIDEGREES=1382
CONFIG_BIOFLOC_TEMP_VOLTAGE_DIVIDER_FACTOR=1500

# ---- pH Sensor Configuration ----
# Hardware: Divisor R1=10kΩ, R2=20kΩ → factor 1.5
CONFIG_BIOFLOC_PH_VOLTAGE_DIVIDER_FACTOR=1500
```

## test_led_project/sdkconfig.defaults.example
```kconfig
# Configuración básica para micro-ROS
CONFIG_MICRO_ROS_APP_STACK=16000
CONFIG_MICRO_ROS_APP_TASK_PRIO=5

# Agente micro-ROS (ajusta a tu red)
CONFIG_MICRO_ROS_AGENT_IP="192.168.1.100"
CONFIG_MICRO_ROS_AGENT_PORT="8888"

# WiFi (REEMPLAZA CON TUS CREDENCIALES)
CONFIG_ESP_WIFI_SSID="YOUR_WIFI_SSID"
CONFIG_ESP_WIFI_PASSWORD="YOUR_WIFI_PASSWORD"
```
